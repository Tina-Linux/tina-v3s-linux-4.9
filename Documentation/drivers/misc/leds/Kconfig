## Documentation/drivers/misc/leds/Kconfig
```kconfig
#
#  Touchscreen driver configuration
#
config  MISC_PWM_LEDS
	tristate "LEDs by PWM Control driver"
	depends on PWM
	default m
	help
		Generic PWM framework driver for LEDS about breathing,and so on.
```

## drivers/hwmon/da380/Kconfig
```kconfig
#
# I2C gsensor chip drivers configuration
#

menuconfig DA380 
	bool "DA380 support"

if DA380
	  
config SENSORS_DA380
	tristate "DA380 acceleration sensor support"
	depends on I2C
	default m
	help
	  If you say yes here you get support for Bosch Sensortec's 
	  acceleration sensors DA380.
config DA280
	bool "DA280"
	depends on SENSORS_DA380
	default n

config DA280_INTERRUPT_LOW_LEVEL
	bool "DA280_INTERRUPT_LOW_LEVEL"
	depends on SENSORS_DA380
	default n	
endif
```

## drivers/video/fbdev/sunxi/lcd_fb/panels/Kconfig
```kconfig
config LCD_SUPPORT_KLD39501
	bool "LCD support kld39501 panel"
	default n
	---help---
		If you want to support kld39501 panel for display driver, select it.

config LCD_SUPPORT_KLD2844B
	bool "LCD support kld2844B panel"
	default y
	---help---
		If you want to support kld2844b panel for display driver, select it.
```
